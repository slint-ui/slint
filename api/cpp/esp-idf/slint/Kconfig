## api/cpp/esp-idf/slint/Kconfig
```kconfig
# Copyright © SixtyFPS GmbH <info@slint.dev>
# SPDX-License-Identifier: GPL-3.0-only OR LicenseRef-Slint-Royalty-free-2.0 OR LicenseRef-Slint-Software-3.0

# cSpell: ignore endmenu UNICORE

menu "Slint"

    config SLINT_TRACING
        bool "Record tracing spans and send them over the console"
        default n
        help
            Records the tracing spans of the Slint runtime, such as walking the item tree
            and drawing each item, for 5 seconds starting 2 seconds after start-up. Then
            sends them over the console, which blocks the UI until done.
            Capture them with `idf.py trace`, which opens the result in Tracy.

    config SLINT_LOG_FRAME_STATS
        bool "Log frame statistics every second"
        default n
        help
            Logs how many frames were rendered in the last second, and how long rendering and
            presenting took on average. Compare a build with SLINT_TRACING to one without to see
            how much tracing slows rendering down.

endmenu
```
