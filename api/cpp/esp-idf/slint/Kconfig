## api/cpp/esp-idf/slint/Kconfig
```kconfig
# Copyright © SixtyFPS GmbH <info@slint.dev>
# SPDX-License-Identifier: GPL-3.0-only OR LicenseRef-Slint-Royalty-free-2.0 OR LicenseRef-Slint-Software-3.0

# cSpell: ignore endmenu UNICORE

menu "Slint"

    config SLINT_PPA
        bool "Draw with the PPA"
        default y
        depends on SOC_PPA_SUPPORTED && SLINT_RENDER_ON_SECOND_CORE
        help
            The task that rasterizes hands opaque solid fills, and images inside an element
            with `cache-rendering-hint: true`, to the Pixel-Processing Accelerator.
            The renderer first prepares each such image at its drawn size, and keeps it.
            The CPU still draws everything else.

    config SLINT_RENDER_ON_SECOND_CORE
        bool "Rasterize and present on the second core"
        default n
        depends on !FREERTOS_UNICORE
        help
            With a frame buffer, the event loop only records each frame,
            and a task on the second core rasterizes and presents it,
            while the event loop goes on with the next frame.
            A frame then takes as long as the slower of the two, instead of both.

    config SLINT_RASTER_TASK_STACK_SIZE
        int "Stack size of the task that rasterizes, in bytes"
        default 8192
        depends on SLINT_RENDER_ON_SECOND_CORE

    config SLINT_CPU_TEXTURES
        bool "Draw hinted images with a whole-image CPU loop"
        default n
        help
            With a full frame buffer, blends each image inside an element with
            `cache-rendering-hint: true` in one pass over its visible rows, instead of the
            software renderer's per-line path. The renderer first prepares the image at its
            drawn size, and keeps it.

    config SLINT_PREPARED_TEXTURES_SIZE
        int "Memory for prepared images, in KiB"
        default 8192
        depends on (SLINT_CPU_TEXTURES || SLINT_PPA) && SLINT_RENDER_ON_SECOND_CORE
        help
            When the next image doesn't fit, all prepared images are dropped.
            Larger images aren't prepared, so 0 turns preparing off.

    config SLINT_TRACING
        bool "Record tracing spans and send them over the console"
        default n
        help
            Records the tracing spans of the Slint runtime, such as walking the item tree
            and drawing each item, for 5 seconds starting 2 seconds after start-up. Then
            sends them over the console, which blocks the UI until done.
            Capture them with `idf.py trace`, which opens the result in Tracy.

    config SLINT_LOG_FRAME_STATS
        bool "Log frame statistics every second"
        default n
        help
            Logs how many frames were rendered in the last second, and how long rendering and
            presenting took on average. Compare a build with SLINT_TRACING to one without to see
            how much tracing slows rendering down.

endmenu
```
