## demos/home-automation/esp-idf/sdkconfig.defaults
```kconfig
CONFIG_IDF_TARGET="esp32p4"
CONFIG_ESPTOOLPY_FLASHMODE_QIO=y
CONFIG_ESPTOOLPY_FLASHSIZE_16MB=y
CONFIG_ESPTOOLPY_FLASHSIZE="16MB"
CONFIG_PARTITION_TABLE_CUSTOM=y
CONFIG_PARTITION_TABLE_CUSTOM_FILENAME="partitions.csv"
CONFIG_COMPILER_OPTIMIZATION_PERF=y
CONFIG_SPIRAM=y
CONFIG_SPIRAM_MODE_HEX=y
CONFIG_SPIRAM_SPEED_200M=y
CONFIG_SPIRAM_FETCH_INSTRUCTIONS=y
CONFIG_SPIRAM_RODATA=y
CONFIG_FREERTOS_HZ=1000
CONFIG_BSP_LCD_COLOR_FORMAT_RGB565=y
CONFIG_BSP_LCD_TYPE_1024_600=y
CONFIG_ESP_MAIN_TASK_STACK_SIZE=120584
CONFIG_FREERTOS_TASK_CREATE_ALLOW_EXT_MEM=y
```

## demos/printerdemo_mcu/esp-idf/sdkconfig.defaults
```kconfig
CONFIG_IDF_TARGET="esp32s3"
CONFIG_ESPTOOLPY_FLASHMODE_QIO=y
CONFIG_ESPTOOLPY_FLASHSIZE_16MB=y
CONFIG_ESPTOOLPY_FLASHSIZE="16MB"
CONFIG_PARTITION_TABLE_CUSTOM=y
CONFIG_PARTITION_TABLE_FILENAME="partitions.csv"
CONFIG_COMPILER_OPTIMIZATION_PERF=y
CONFIG_SPIRAM=y
CONFIG_SPIRAM_MODE_OCT=y
CONFIG_SPIRAM_FETCH_INSTRUCTIONS=y
CONFIG_SPIRAM_RODATA=y
CONFIG_SPIRAM_SPEED_80M=y
CONFIG_ESP32S3_INSTRUCTION_CACHE_32KB=y
CONFIG_ESP_DEFAULT_CPU_FREQ_MHZ_240=y
CONFIG_ESP32S3_DATA_CACHE_64KB=y
CONFIG_ESP32S3_DATA_CACHE_LINE_64B=y
CONFIG_ESP32S3_SPIRAM_SUPPORT=y
CONFIG_FREERTOS_HZ=1000
CONFIG_MAIN_TASK_STACK_SIZE=150000
```

## demos/zephyr-common/boards/frdm_mcxn947_mcxn947_cpu0.conf
```kconfig
# Copyright © SixtyFPS GmbH <info@slint.dev>
# SPDX-License-Identifier: MIT

# Stack size for Slint rendering (needs ~16KB+ for software renderer)
CONFIG_MAIN_STACK_SIZE=49152

# Enable hardware FPU with hard-float ABI (required for Rust thumbv8m.main-none-eabihf target)
CONFIG_FPU=y
CONFIG_FP_HARDABI=y

# Enable DMA for display
CONFIG_DMA=y

# MIPI DBI parallel display interface
CONFIG_MIPI_DBI=y

# Input for touch support
CONFIG_INPUT=y
CONFIG_INPUT_GT911=y
CONFIG_INPUT_GT911_INTERRUPT=y

# Display settings
CONFIG_DISPLAY=y

# Use macro-based sysconf to avoid missing _POSIX_TZNAME_MAX
CONFIG_POSIX_SYSCONF_IMPL_MACRO=y

# Increase system workqueue stack for GT911 touch driver
CONFIG_SYSTEM_WORKQUEUE_STACK_SIZE=4096

# Increase input event queue size
CONFIG_INPUT_QUEUE_MAX_MSGS=256

# Use dedicated thread for input processing
CONFIG_INPUT_MODE_THREAD=y
CONFIG_INPUT_THREAD_STACK_SIZE=8192
```

## demos/zephyr-common/boards/mimxrt1170_evk_mimxrt1176_cm7.conf
```kconfig
# Copyright © SixtyFPS GmbH <info@slint.dev>
# SPDX-License-Identifier: MIT

# Set a large stack size to prevent MPU FAULT: Stacking error (context area might be not valid)
CONFIG_MAIN_STACK_SIZE=32768

# Enable hardware FPU with hard-float ABI (required for Rust thumbv7em-none-eabihf target)
CONFIG_FPU=y
CONFIG_FP_HARDABI=y

# Enable the PXP and DMA API
CONFIG_DMA=y
CONFIG_MCUX_ELCDIF_PXP=y
CONFIG_MCUX_ELCDIF_PXP_ROTATE_90=y
```

## demos/zephyr-common/boards/native_sim_64.conf
```kconfig
# Copyright © SixtyFPS GmbH <info@slint.dev>
# SPDX-License-Identifier: MIT

CONFIG_INPUT_SDL_TOUCH=y
```

## demos/zephyr-common/boards/rza3m_ek.conf
```kconfig
# Copyright © SixtyFPS GmbH <info@slint.dev>
# SPDX-License-Identifier: MIT

CONFIG_MAIN_STACK_SIZE=65536
CONFIG_HEAP_MEM_POOL_SIZE=16777216
CONFIG_COMMON_LIBC_MALLOC_ARENA_SIZE=8388608

CONFIG_DISPLAY=y
CONFIG_MIPI_DSI=y
CONFIG_GPIO=y

CONFIG_INPUT=y
CONFIG_INPUT_GT911=y
CONFIG_INPUT_QUEUE_MAX_MSGS=64
```

## examples/carousel/esp-idf/s2-kaluga-kit/sdkconfig.defaults
```kconfig
CONFIG_IDF_TARGET="esp32s2"
CONFIG_ESPTOOLPY_FLASHSIZE_4MB=y
CONFIG_COMPILER_OPTIMIZATION_PERF=y
CONFIG_ESP_DEFAULT_CPU_FREQ_MHZ_240=y
CONFIG_FREERTOS_HZ=1000
CONFIG_ESP_MAIN_TASK_STACK_SIZE=13584
CONFIG_COMPILER_CXX_EXCEPTIONS=y
```

## examples/carousel/esp-idf/s3-usb-otg/sdkconfig.defaults
```kconfig
CONFIG_IDF_TARGET="esp32s3"
CONFIG_ESPTOOLPY_FLASHSIZE_8MB=y
CONFIG_COMPILER_OPTIMIZATION_PERF=y
CONFIG_ESP_DEFAULT_CPU_FREQ_MHZ_240=y
CONFIG_ESP32S3_DATA_CACHE_64KB=y
CONFIG_ESP32S3_DATA_CACHE_LINE_64B=y
CONFIG_FREERTOS_HZ=1000
CONFIG_MAIN_TASK_STACK_SIZE=13584
CONFIG_COMPILER_CXX_EXCEPTIONS=y
```

## yocto/meta-slint-demos/conf/layer.conf
```bitbake
# Copyright © SixtyFPS GmbH <info@slint.dev>
# SPDX-License-Identifier: MIT

BBPATH .= ":${LAYERDIR}"
BBFILES += "${LAYERDIR}/recipes-*/*/*.bb ${LAYERDIR}/recipes-*/*/*.bbappend"

BBFILE_COLLECTIONS += "slint-demos"
BBFILE_PATTERN_slint-demos = "^${LAYERDIR}/"
BBFILE_PRIORITY_slint-demos = "10"

LAYERDEPENDS_slint-demos = "core openembedded-layer"
LAYERSERIES_COMPAT_slint-demos = "scarthgap walnascar whinlatter wrynose"
```
