## CMakeLists.txt
```
# Copyright © SixtyFPS GmbH <info@slint.dev>
# SPDX-License-Identifier: MIT

cmake_minimum_required(VERSION 3.20.0)

if(NOT BOARD)
    message(FATAL_ERROR "No BOARD option specified")
endif()

if(BOARD STREQUAL "native_sim/native/64")
    set(Rust_CARGO_TARGET "x86_64-unknown-linux-gnu")
    set(SLINT_LIBRARY_CARGO_FLAGS "-Zbuild-std=core,alloc")
elseif(BOARD STREQUAL "mimxrt1170_evk@B/mimxrt1176/cm7")
    set(Rust_CARGO_TARGET "thumbv7em-none-eabi")
else()
    # See rustc --print target-list for available targets. Match that up with you supported board
    # https://docs.zephyrproject.org/latest/boards
    message(FATAL_ERROR "Unsupported BOARD option specified: ${BOARD}")
endif()

if(SHIELD STREQUAL "rk055hdmipi4ma0")
    set(EXTRA_DTC_OVERLAY_FILE "${CMAKE_CURRENT_LIST_DIR}/boards/shields/rk055hdmipi4ma0/rk055hdmipi4ma0.overlay")
endif()

find_package(Zephyr)
project(slint_zephyr_printer_demo_mcu LANGUAGES CXX)

set(SLINT_FEATURE_FREESTANDING ON)
set(SLINT_FEATURE_RENDERER_SOFTWARE ON)
set(DEFAULT_SLINT_EMBED_RESOURCES "embed-for-software-renderer" CACHE STRING "")
# set(CMAKE_BUILD_TYPE Release)
set(BUILD_SHARED_LIBS OFF)

# Work around gcc_s linker issue?
set(Rust_CARGO_TARGET_LINK_NATIVE_LIBS "" CACHE INTERNAL "" FORCE)

# TODO: FetchContent?
add_subdirectory(../../.. slint_build)

# The app target is defined by the call to find_package(Zephyr)
target_sources(app PRIVATE src/slint-zephyr.cpp src/main.cpp)
target_link_libraries(app PRIVATE Slint::Slint)

slint_target_sources(app ../../printerdemo/ui/printerdemo.slint)
```

## prj.conf
```kconfig
CONFIG_CPP=y
CONFIG_STD_CPP20=y
CONFIG_REQUIRES_FULL_LIBCPP=y
CONFIG_POSIX_API=y

CONFIG_LOG=y
CONFIG_ASSERT=y

CONFIG_DISPLAY=y
CONFIG_INPUT=y
```

## boards/mimxrt1170_evk_mimxrt1176_cm7.conf
```kconfig
# Copyright © SixtyFPS GmbH <info@slint.dev>
# SPDX-License-Identifier: MIT

# Set a large stack size to prevent MPU FAULT: Stacking error (context area might be not valid)
CONFIG_MAIN_STACK_SIZE=32768

# Enable the PXP and DMA API
CONFIG_DMA=y
CONFIG_MCUX_ELCDIF_PXP=y
```

## boards/native_sim_64.conf
```kconfig
CONFIG_INPUT_SDL_TOUCH=y
```

## boards/native_sim_64.overlay
```dts
// Copyright © SixtyFPS GmbH <info@slint.dev>
// SPDX-License-Identifier: MIT

/{
	aliases {
		slint-input = &input_sdl_touch;
	};
};

&sdl_dc {
	height = <720>;
	width = <1280>;
};
```

## boards/shields/rk055hdmipi4ma0/rk055hdmipi4ma0.overlay
```dts
/{
	aliases {
		slint-input = &gt911_rk055hdmipi4ma0;
	};
};
```

## src/main.cpp
```c
#include <zephyr/logging/log.h>
LOG_MODULE_REGISTER(zephyrPrinterDemo, LOG_LEVEL_INF);

#include <zephyr/kernel.h>
#include <zephyr/device.h>
#include <zephyr/drivers/display.h>

#ifdef CONFIG_ARCH_POSIX
#    include "posix_board_if.h"
#endif

#include <app_version.h>

#include "slint-zephyr.h"

#include "printerdemo.h"

struct InkLevelModel : slint::Model<InkLevel>
{
    size_t row_count() const override { return m_data.size(); }
    std::optional<InkLevel> row_data(size_t i) const override
    {
        if (i < row_count())
            return { m_data[i] };
        return {};
    }

    std::vector<InkLevel> m_data = { { slint::Color::from_rgb_uint8(255, 255, 0), 0.9 },
                                     { slint::Color::from_rgb_uint8(0, 255, 255), 0.5 },
                                     { slint::Color::from_rgb_uint8(255, 0, 255), 0.8 },
                                     { slint::Color::from_rgb_uint8(0, 0, 0), 0.1 } };
};

int main(void)
{
    printk("Slint Printer Demo with Zephyr %s\n", APP_VERSION_STRING);

    const struct device *display_dev = nullptr;

    display_dev = DEVICE_DT_GET(DT_CHOSEN(zephyr_display));
    if (!device_is_ready(display_dev)) {
        LOG_ERR("Device %s not found. Aborting.", display_dev->name);
#ifdef CONFIG_ARCH_POSIX
        posix_exit(1);
#else
        return 0;
#endif
    }

    slint_zephyr_init(display_dev);

    auto printer_demo = MainWindow::create();
    printer_demo->set_ink_levels(std::make_shared<InkLevelModel>());
    printer_demo->on_quit([] { std::exit(0); });

    auto printer_queue = std::make_shared<slint::VectorModel<PrinterQueueItem>>();
    auto default_queue = printer_demo->global<PrinterQueue>().get_printer_queue();
    for (int i = 0; i < default_queue->row_count(); ++i) {
        printer_queue->push_back(*default_queue->row_data(i));
    }
    printer_demo->global<PrinterQueue>().set_printer_queue(printer_queue);

    printer_demo->global<PrinterQueue>().on_start_job([=](slint::SharedString name) {
        std::time_t now = std::chrono::system_clock::to_time_t(std::chrono::system_clock::now());
        char time_buf[100] = { 0 };
        std::strftime(time_buf, sizeof(time_buf), "%H:%M:%S %d/%m/%Y", std::localtime(&now));
        PrinterQueueItem item;
        item.status = JobStatus::Waiting;
        item.progress = 0;
        item.title = std::move(name);
        item.owner = "joe@example.com";
        item.pages = 1;
        item.size = "100kB";
        item.submission_date = time_buf;
        printer_queue->push_back(item);
    });

    printer_demo->global<PrinterQueue>().on_cancel_job(
            [=](int index) { printer_queue->erase(int(index)); });

    slint::Timer printer_queue_progress_timer(std::chrono::seconds(1), [=]() {
        if (printer_queue->row_count() > 0) {
            auto top_item = *printer_queue->row_data(0);
            top_item.progress += 1;
            if (top_item.progress > 100) {
                printer_queue->erase(0);
            } else {
                top_item.status = JobStatus::Printing;
                printer_queue->set_row_data(0, top_item);
            }
        }
    });

    printer_demo->run();
    return 0;
}
```

## src/slint-zephyr.cpp
```c
// Copyright © SixtyFPS GmbH <info@slint.dev>
// SPDX-License-Identifier: MIT

#include "slint-zephyr.h"

#include <slint-platform.h>

#include <zephyr/logging/log.h>
LOG_MODULE_REGISTER(zephyrSlint, LOG_LEVEL_DBG);

#include <zephyr/kernel.h>
#include <zephyr/drivers/display.h>
#include <zephyr/input/input.h>

#include <chrono>
#include <deque>
#include <ranges>

namespace {
bool is_supported_pixel_format(display_pixel_format current_pixel_format)
{
    switch (current_pixel_format) {
    case PIXEL_FORMAT_RGB_565:
        return true;
    case PIXEL_FORMAT_RGB_888:
        // Slint supports this format, but it uses more space.
        return false;
    case PIXEL_FORMAT_BGR_565:
#ifdef CONFIG_SHIELD_RK055HDMIPI4MA0
        // Zephyr expects pixel data to be big endian [1].

        // The display driver expects RGB 565 pixel data [2], and appears to expect it to be little
        // endian.

        // By passing Slint's little endian, RGB 565 pixel data without converting to big endian as
        // Zephyr expects, we get colors that work.

        // [1]
        // https://docs.zephyrproject.org/latest/hardware/peripherals/display/index.html#c.display_pixel_format
        // [2]
        // https://github.com/zephyrproject-rtos/zephyr/blob/c211cb347e0af0a4931e0e7af3d93577bcc7af8f/drivers/display/display_mcux_elcdif.c#L256

        // See also:
        // https://github.com/zephyrproject-rtos/zephyr/issues/53642
        return true;
#else
        return false;
#endif
        return false;
    case PIXEL_FORMAT_MONO01:
    case PIXEL_FORMAT_MONO10:
    case PIXEL_FORMAT_ARGB_8888:
        return false;
    }
    assert(false);
}

struct k_unique_lock
{
    k_unique_lock(struct k_mutex *m) : mutex(m) { k_mutex_lock(mutex, K_FOREVER); }
    ~k_unique_lock() { k_mutex_unlock(mutex); }
    struct k_mutex *mutex = nullptr;
};

struct RotationInfo
{
    using RenderingRotation = slint::platform::SoftwareRenderer::RenderingRotation;
    RenderingRotation rotation = RenderingRotation::NoRotation;
    slint::PhysicalSize size;

    bool is_transpose() const
    {
        return rotation == RenderingRotation::Rotate90 || rotation == RenderingRotation::Rotate270;
    }

    bool mirror_width() const
    {
        return rotation == RenderingRotation::Rotate180 || rotation == RenderingRotation::Rotate270;
    }

    bool mirror_height() const
    {
        return rotation == RenderingRotation::Rotate90 || rotation == RenderingRotation::Rotate180;
    }
};

slint::LogicalPosition transformed(slint::LogicalPosition p, const RotationInfo &info)
{
    if (info.mirror_width())
        p.x = info.size.width - p.x - 1;
    if (info.mirror_height())
        p.y = info.size.height - p.y - 1;
    if (info.is_transpose())
        std::swap(p.x, p.y);
    return p;
}

slint::PhysicalSize transformed(slint::PhysicalSize s, const RotationInfo &info)
{
    if (info.is_transpose())
        std::swap(s.width, s.height);
    return s;
}
}

using namespace std::chrono_literals;

using RepaintBufferType = slint::platform::SoftwareRenderer::RepaintBufferType;

K_SEM_DEFINE(SLINT_SEM, 0, 1);

class ZephyrPlatform : public slint::platform::Platform
{
public:
    explicit ZephyrPlatform(const struct device *display);

    std::unique_ptr<slint::platform::WindowAdapter> create_window_adapter() override;
    std::chrono::milliseconds duration_since_start() override;
    void run_event_loop() override;
    void quit_event_loop() override;
    void run_in_event_loop(Task) override;

private:
    const struct device *m_display;
    class ZephyrWindowAdapter *m_window = nullptr;

    struct k_mutex m_queue_mutex;
    std::deque<slint::platform::Platform::Task> m_queue; // protected by m_queue_mutex
    bool m_quit = false; // protected by m_queue_mutex
};

class ZephyrWindowAdapter : public slint::platform::WindowAdapter
{
public:
    static std::unique_ptr<ZephyrWindowAdapter> init_from(const device *display);

    explicit ZephyrWindowAdapter(const device *display, RepaintBufferType buffer_type,
                                 const RotationInfo &info);

    void request_redraw() override;
    slint::PhysicalSize size() override;
    slint::platform::AbstractRenderer &renderer() override;

    void maybe_redraw();

    const RotationInfo &rotationInfo() const;

private:
    slint::platform::SoftwareRenderer m_renderer;

    const struct device *m_display;
    const RotationInfo m_rotationInfo;
    const slint::PhysicalSize m_size;

    bool m_needs_redraw = true;
    std::vector<slint::platform::Rgb565Pixel> m_buffer;
    display_buffer_descriptor m_buffer_descriptor;
};

static ZephyrWindowAdapter *ZEPHYR_WINDOW = nullptr;

std::unique_ptr<ZephyrWindowAdapter> ZephyrWindowAdapter::init_from(const device *display)
{
    display_capabilities capabilities;
    display_get_capabilities(display, &capabilities);

    // TODO: Double buffer
    RepaintBufferType bufferType = RepaintBufferType::ReusedBuffer;
    // if (capabilities.screen_info & SCREEN_INFO_DOUBLE_BUFFER)
    //     bufferType = RepaintBufferType::SwappedBuffers;

    LOG_INF("Screen size: %u x %u", capabilities.x_resolution, capabilities.y_resolution);
    LOG_INF("Double buffering: %d", (capabilities.screen_info & SCREEN_INFO_DOUBLE_BUFFER));
    LOG_INF("Has framebuffer: %d", (display_get_framebuffer(display) != nullptr));

    switch (capabilities.current_pixel_format) {
    case PIXEL_FORMAT_RGB_565:
        LOG_INF("Pixel format: RGB_565");
        break;
    case PIXEL_FORMAT_RGB_888:
        // Slint supports this format, but it uses more space.
        LOG_WRN("Unsupported pixel format: RGB_888");
        break;
    case PIXEL_FORMAT_MONO01:
        LOG_WRN("Unsupported pixel format: MONO01");
        break;
    case PIXEL_FORMAT_MONO10:
        LOG_WRN("Unsupported pixel format: MONO10");
        break;
    case PIXEL_FORMAT_ARGB_8888:
        LOG_WRN("Unsupported pixel format: ARGB_8888");
        break;
    case PIXEL_FORMAT_BGR_565:
        LOG_WRN("Unsupported pixel format: BGR_565");
        break;
    }

    LOG_INF("Supports RGB_888: %d",
            static_cast<bool>(capabilities.supported_pixel_formats & PIXEL_FORMAT_RGB_888));
    LOG_INF("Supports MONO01: %d",
            static_cast<bool>(capabilities.supported_pixel_formats & PIXEL_FORMAT_MONO01));
    LOG_INF("Supports MONO10: %d",
            static_cast<bool>(capabilities.supported_pixel_formats & PIXEL_FORMAT_MONO10));
    LOG_INF("Supports ARGB_8888: %d",
            static_cast<bool>(capabilities.supported_pixel_formats & PIXEL_FORMAT_ARGB_8888));
    LOG_INF("Supports RGB_565: %d",
            static_cast<bool>(capabilities.supported_pixel_formats & PIXEL_FORMAT_RGB_565));
    LOG_INF("Supports BGR_565: %d",
            static_cast<bool>(capabilities.supported_pixel_formats & PIXEL_FORMAT_BGR_565));

    if (!is_supported_pixel_format(capabilities.current_pixel_format)) {
        if (capabilities.supported_pixel_formats & PIXEL_FORMAT_RGB_565) {
            LOG_INF("Switching to RGB_565");
            if (const auto result = display_set_pixel_format(display, PIXEL_FORMAT_RGB_565);
                result != 0) {
                LOG_ERR("Failed to set pixel format: %d", result);
            }
        } else {
            LOG_WRN("No supported pixel formats!");
        }
    }

    RotationInfo info;
    info.size = slint::PhysicalSize({ capabilities.x_resolution, capabilities.y_resolution });
    if (IS_ENABLED(CONFIG_MCUX_ELCDIF_PXP_ROTATE_90))
        info.rotation = slint::platform::SoftwareRenderer::RenderingRotation::Rotate270;
    else if (IS_ENABLED(CONFIG_MCUX_ELCDIF_PXP_ROTATE_180))
        info.rotation = slint::platform::SoftwareRenderer::RenderingRotation::Rotate180;
    else if (IS_ENABLED(CONFIG_MCUX_ELCDIF_PXP_ROTATE_270))
        info.rotation = slint::platform::SoftwareRenderer::RenderingRotation::Rotate90;

    const auto rotatedSize = transformed(info.size, info);
    LOG_INF("Rotated screen size: %u x %u", rotatedSize.width, rotatedSize.height);
    return std::make_unique<ZephyrWindowAdapter>(display, bufferType, info);
}

ZephyrWindowAdapter::ZephyrWindowAdapter(const device *display, RepaintBufferType buffer_type,
                                         const RotationInfo &info)
    : m_renderer(buffer_type),
      m_display(display),
      m_rotationInfo(info),
      m_size(transformed(m_rotationInfo.size, m_rotationInfo))
{
    m_buffer.resize(m_size.width * m_size.height);

    m_buffer_descriptor.buf_size = sizeof(m_buffer[0]) * m_buffer.size();
    m_buffer_descriptor.width = m_size.width;
    m_buffer_descriptor.height = m_size.height;
    m_buffer_descriptor.pitch = m_size.width;
}

void ZephyrWindowAdapter::request_redraw()
{
    m_needs_redraw = true;
}

slint::PhysicalSize ZephyrWindowAdapter::size()
{
    return m_size;
}

slint::platform::AbstractRenderer &ZephyrWindowAdapter::renderer()
{
    return m_renderer;
}

void ZephyrWindowAdapter::maybe_redraw()
{
    if (!std::exchange(m_needs_redraw, false))
        return;

    auto start = k_uptime_get();
    auto region = m_renderer.render(m_buffer, m_size.width);
    const auto slintRenderDelta = k_uptime_delta(&start);
    LOG_DBG("Rendering %d dirty regions:", std::ranges::size(region.rectangles()));
    for (auto [o, s] : region.rectangles()) {
#ifndef CONFIG_SHIELD_RK055HDMIPI4MA0
        // Convert to big endian pixel data for Zephyr, unless we are using the RK055HDMIPI4MA0
        // shield. See is_supported_pixel_format above.
        for (int y = o.y; y < o.y + s.height; y++) {
            for (int x = o.x; x < o.x + s.width; x++) {
                auto px = reinterpret_cast<uint16_t *>(&m_buffer[y * m_size.width + x]);
                *px = (*px << 8) | (*px >> 8);
            }
        }
#endif

#ifdef CONFIG_MCUX_ELCDIF_PXP
        // The display driver cannot do partial updates when the PXP is using the DMA API.
        if (const auto ret =
                    display_write(m_display, 0, 0, &m_buffer_descriptor, m_buffer.data()) != 0) {
            LOG_WRN("display_write returned non-zero: %d", ret);
        }
#else
        m_buffer_descriptor.width = s.width;
        m_buffer_descriptor.height = s.height;

        if (const auto ret = display_write(m_display, o.x, o.y, &m_buffer_descriptor,
                                           m_buffer.data() + ((o.y * m_size.width) + o.x))
                    != 0) {
            LOG_WRN("display_write returned non-zero: %d", ret);
        }
#endif
        LOG_DBG("   - rendered x: %d y: %d w: %d h: %d", o.x, o.y, s.width, s.height);
    }
    const auto displayWriteDelta = k_uptime_delta(&start);
    LOG_DBG(" - total: %lld ms, slint: %lld ms, write: %lld ms",
            slintRenderDelta + displayWriteDelta, slintRenderDelta, displayWriteDelta);
}

const RotationInfo &ZephyrWindowAdapter::rotationInfo() const
{
    return m_rotationInfo;
}

ZephyrPlatform::ZephyrPlatform(const struct device *display) : m_display(display)
{
    k_mutex_init(&m_queue_mutex);
}

std::unique_ptr<slint::platform::WindowAdapter> ZephyrPlatform::create_window_adapter()
{
    if (m_window || ZEPHYR_WINDOW) {
        LOG_ERR("create_window_adapter called multiple times");
        return nullptr;
    }

    auto window = ZephyrWindowAdapter::init_from(m_display);
    m_window = window.get();
    ZEPHYR_WINDOW = m_window;
    return window;
}

std::chrono::milliseconds ZephyrPlatform::duration_since_start()
{
    // Better precision could be provided by k_uptime_ticks()
    return std::chrono::milliseconds(k_uptime_get());
}

void ZephyrPlatform::run_event_loop()
{
    LOG_DBG("Start");

    while (true) {
        LOG_DBG("Loop");
        slint::platform::update_timers_and_animations();

        std::optional<slint::platform::Platform::Task> event;
        {
            k_unique_lock lock(&m_queue_mutex);
            if (m_queue.empty()) {
                if (m_quit) {
                    m_quit = false;
                    break;
                }
            } else {
                event = std::move(m_queue.front());
                m_queue.pop_front();
            }
        }
        if (event) {
            LOG_DBG("Running event");
            std::move(*event).run();
            event.reset();
            continue;
        }

        if (m_window) {
            m_window->maybe_redraw();

            if (m_window->window().has_active_animations()) {
                LOG_DBG("Has active animations");
#if defined(CONFIG_ARCH_POSIX)
                // The Zephyr POSIX architecture used by the native simulator is unable to interrupt
                // a busy thread. Therefore we must sleep here to allow other threads to progress,
                // otherwise we end up in an infinite loop.
                // https://docs.zephyrproject.org/3.7.0/boards/native/doc/arch_soc.html#important-limitations
                constexpr long simulatorSleepTime = 10;
                LOG_DBG("Sleeping for %llims", simulatorSleepTime);
                k_sem_take(&SLINT_SEM, K_MSEC(simulatorSleepTime));
#endif
                continue;
            }
        }

        if (auto next_timer_update = slint::platform::duration_until_next_timer_update()) {
            const auto wait_time_ms = next_timer_update.value().count();
            LOG_DBG("Sleeping for %llims", wait_time_ms);
            k_sem_take(&SLINT_SEM, K_MSEC(wait_time_ms));
        } else {
            LOG_DBG("Sleeping for forever");
            k_sem_take(&SLINT_SEM, K_FOREVER);
        }
    }
}

void ZephyrPlatform::quit_event_loop()
{
    {
        k_unique_lock lock(&m_queue_mutex);
        m_quit = true;
    }
    k_sem_give(&SLINT_SEM);
}

void ZephyrPlatform::run_in_event_loop(Task event)
{
    {
        k_unique_lock lock(&m_queue_mutex);
        m_queue.push_back(std::move(event));
    }
    k_sem_give(&SLINT_SEM);
}

void zephyr_process_input_event(struct input_event *event)
{
    static slint::LogicalPosition pos;
    static std::optional<slint::PointerEventButton> button;

    LOG_DBG("Input event. Type: %#x, code: %u (%#x), value: %d, sync: %d", event->type, event->type,
            event->code, event->value, event->sync);

    switch (event->code) {
    case INPUT_BTN_TOUCH:
        break;
    case INPUT_ABS_X:
        pos.x = event->value;
        break;
    case INPUT_ABS_Y:
        pos.y = event->value;
        break;
    default:
        LOG_WRN("Unexpected input event. Type: %#x, code: %u (%#x), value: %d, sync: %d",
                event->type, event->type, event->code, event->value, event->sync);
        return;
    }

    if (event->sync) {
        __ASSERT(event->code == INPUT_BTN_TOUCH,
                 "Expected touch press/release events to be driving the sync status");

        if (!button.has_value()) {
            if (!event->value)
                return;

            LOG_DBG("Press");
            button = slint::PointerEventButton::Left;
            slint::invoke_from_event_loop([=, button = button.value()] {
                __ASSERT(ZEPHYR_WINDOW, "Expected ZephyrWindowAdapter");
                // Transform the physical screen position to the rendered position
                const auto slintPos = transformed(pos, ZEPHYR_WINDOW->rotationInfo());
                ZEPHYR_WINDOW->window().dispatch_pointer_move_event(slintPos);
                ZEPHYR_WINDOW->window().dispatch_pointer_press_event(slintPos, button);
            });
        } else if (event->value) {
            LOG_DBG("Move");
            slint::invoke_from_event_loop([=] {
                __ASSERT(ZEPHYR_WINDOW, "Expected ZephyrWindowAdapter");
                // Transform the physical screen position to the rendered position
                const auto slintPos = transformed(pos, ZEPHYR_WINDOW->rotationInfo());
                ZEPHYR_WINDOW->window().dispatch_pointer_move_event(slintPos);
            });
        } else {
            LOG_DBG("Release");
            slint::invoke_from_event_loop([=, button = button.value()] {
                __ASSERT(ZEPHYR_WINDOW, "Expected ZephyrWindowAdapter");
                // Transform the physical screen position to the rendered position
                const auto slintPos = transformed(pos, ZEPHYR_WINDOW->rotationInfo());
                ZEPHYR_WINDOW->window().dispatch_pointer_release_event(slintPos, button);
                ZEPHYR_WINDOW->window().dispatch_pointer_exit_event();
            });
            button.reset();
        }
    }
}

INPUT_CALLBACK_DEFINE(DEVICE_DT_GET(DT_ALIAS(slint_input)), zephyr_process_input_event);

void slint_zephyr_init(const struct device *display)
{
    display_blanking_off(display);
    slint::platform::set_platform(std::make_unique<ZephyrPlatform>(display));
}
```

## src/slint-zephyr.h
```c
#pragma once

void slint_zephyr_init(const struct device *display);
```
